#include <behaviors.dtsi>
#include <dt-bindings/zmk/keys.h>
#include <dt-bindings/zmk/bt.h>

// ARTS Row
#define KEY_A 2
#define KEY_R 3
#define KEY_T 4
#define KEY_S 5
// EYIO Row
#define KEY_E 6
#define KEY_Y 7
#define KEY_I 8
#define KEY_O 9

// Include main ardux.io keymap
#include "../../../stine_artsey.keymap"
