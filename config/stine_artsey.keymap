#include <behaviors.dtsi>
#include <dt-bindings/zmk/keys.h>
#include <dt-bindings/zmk/outputs.h>

/ {
    keymap {
        compatible = "zmk,keymap";

        default_layer {
            bindings = <
&kp A  &kp R  &kp T  &kp S  &kp E  &kp Y  &kp I  &kp O
            >;
        };
    };
};
